## boards/shields/charybdis_3x5_wired/Kconfig.defconfig
```kconfig
if SHIELD_CHARYBDIS_3X5_WIRED

# Set default board
config BOARD
    default "pro_micro_rp2040"

endif 
```

## boards/shields/charybdis_3x5_wired/Kconfig.shield
```kconfig
config SHIELD_CHARYBDIS_3X5_WIRED
    def_bool $(shields_list_contains,charybdis_left) || $(shields_list_contains,charybdis_right) 
```
